## general/package/ffmpeg-openipc/Config.in
```kconfig
config BR2_PACKAGE_FFMPEG_OPENIPC
	bool "ffmpeg-openipc"
	default n
	help
	  FFmpeg is a complete, cross-platform solution to record,
	  convert and stream audio and video.

	  http://www.ffmpeg.org

if BR2_PACKAGE_FFMPEG_OPENIPC

config BR2_PACKAGE_FFMPEG_OPENIPC_V4L2_MJPEG
	bool "V4L2 capture and MJPEG encode"
	help
	  Adds the V4L2 input and output devices, the rawvideo decoder,
	  the MJPEG encoder and the scale/format filters, so ffmpeg can
	  read a raw (YUYV) UVC camera, JPEG-encode it on the CPU and
	  write the result to a v4l2loopback node for v4l2rtspserver to
	  serve. Everything else stays disabled. On ARM this also turns
	  the assembler optimisations back on, since the encode runs on
	  the camera's CPU.

endif
```

## general/package/fpvcam/Config.in
```kconfig
config BR2_PACKAGE_FPVCAM
	bool "fpvcam"
	depends on BR2_PACKAGE_SIGMASTAR_OSDRV_INFINITY6E
	depends on !BR2_PACKAGE_MAJESTIC
	depends on !BR2_PACKAGE_LIBJPEG_OPENIPC
	select BR2_PACKAGE_JPEG
	help
	  A streamer for an FPV board with a MIPI sensor on a SigmaStar
	  infinity6e SoC and an optional UVC camera. One RTSP server
	  with two paths, /main for the sensor (H.264 or H.265) and /usb
	  for the UVC camera (H.264 or H.265 through a second channel of
	  the SoC's encoder, or MJPEG on the CPU), and a web page on
	  which every setting -- sensor mode, resolution, frame rate,
	  exposure, white balance, picture, bitrate -- is saved to
	  /etc/fpvcam.conf and applied the moment it is changed.

	  The source lives in this package under src/. It is built
	  against the SigmaStar MI headers, which are not in this tree;
	  they are fetched from https://github.com/openipc/research
	  (star/include/infinity6e) at the commit fpvcam.mk pins, and
	  linked against the MI libraries sigmastar-osdrv-infinity6e
	  installs. Those are only installed on a majestic-free image,
	  and two streamers cannot share one sensor, hence the
	  dependency.

comment "fpvcam needs sigmastar-osdrv-infinity6e and a majestic-free image"
	depends on !BR2_PACKAGE_SIGMASTAR_OSDRV_INFINITY6E || BR2_PACKAGE_MAJESTIC

comment "fpvcam conflicts with libjpeg-openipc (both install libjpeg)"
	depends on BR2_PACKAGE_LIBJPEG_OPENIPC
```

## general/package/openipc-usbfpv/Config.in
```kconfig
config BR2_PACKAGE_OPENIPC_USBFPV
	bool "OpenIPC USB FPV profile"
	depends on !BR2_PACKAGE_MAJESTIC
	depends on BR2_LINUX_KERNEL
	depends on BR2_PACKAGE_SIGMASTAR_OSDRV_INFINITY6E
	select BR2_PACKAGE_FPVCAM
	select BR2_PACKAGE_MSPOSD
	help
	  Init scripts and configuration that turn the packages it
	  selects into one firmware: fpvcam serves the sensor over RTSP
	  as rtsp://camera/main and a UVC camera as rtsp://camera/usb,
	  both on port 554, with a settings page on port 80; msposd
	  forwards the flight controller's MSP DisplayPort stream from
	  UART2 to a ground station over UDP, where the OSD is drawn.

	  The UVC camera this was built for, an InfiRay 384x288 thermal
	  core, offers only raw YUYV. fpvcam compresses it with a second
	  channel of the SoC's encoder, or with libjpeg-turbo when its
	  codec is set to mjpeg.

	  Board-specific by design, the way openipc-nfs-root is: the
	  files it installs would start a second streamer on any image
	  that carries majestic, hence the dependency.

comment "openipc-usbfpv is a majestic-free profile for infinity6e"
	depends on BR2_PACKAGE_MAJESTIC || !BR2_PACKAGE_SIGMASTAR_OSDRV_INFINITY6E
```

## general/package/usbmjpeg/Config.in
```kconfig
config BR2_PACKAGE_USBMJPEG
	bool "usbmjpeg"
	depends on !BR2_PACKAGE_LIBJPEG_OPENIPC
	select BR2_PACKAGE_JPEG
	help
	  Reads raw YUYV frames from a V4L2 capture device, JPEG-encodes
	  them with libjpeg and writes the frames into a v4l2loopback
	  output node, so v4l2rtspserver can serve a camera that offers
	  no compressed format of its own. One small C program, no
	  scaling or filtering; with libjpeg-turbo (the jpeg variant
	  buildroot picks on any NEON-capable ARM) the encode runs on
	  SIMD, which is the point: ffmpeg's MJPEG encoder has no NEON
	  DCT and took a whole Cortex-A7 core for a 384x288 thermal
	  camera.

	  Source lives in this package under src/. Usage and defaults:
	  usbmjpeg -h

comment "usbmjpeg conflicts with libjpeg-openipc (both install libjpeg)"
	depends on BR2_PACKAGE_LIBJPEG_OPENIPC
```

## general/package/v4l2loopback-openipc/Config.in
```kconfig
config BR2_PACKAGE_V4L2LOOPBACK_OPENIPC
	bool "v4l2loopback-openipc"
	depends on BR2_LINUX_KERNEL
	help
	  Kernel module that creates virtual V4L2 devices: one program
	  writes frames in, any V4L2 reader sees a camera. The seam
	  between a CPU transcoder and v4l2rtspserver when the real USB
	  camera offers no format the network can carry.

	  A fork of buildroot's own package, minus its kernel config
	  fixups: those force CONFIG_MEDIA_SUPPORT and CONFIG_VIDEO_DEV
	  to =y, and on ssc338q that puts the kernel over its 2048KB
	  partition. This tree's board configs carry them as =m.

	  Load with: modprobe v4l2loopback devices=1 video_nr=10
	  card_label=<name> exclusive_caps=1

	  https://github.com/umlaeute/v4l2loopback
```

## general/package/v4l2rtspserver/Config.in
```kconfig
config BR2_PACKAGE_V4L2RTSPSERVER
	bool "v4l2rtspserver"
	depends on BR2_INSTALL_LIBSTDCPP
	help
	  RTSP server for a V4L2 capture device, built on live555.
	  Streams whatever the device already produces (MJPEG, H.264)
	  without transcoding, which is what makes it fit next to a
	  SoC streamer that owns the ISP: a UVC webcam gets its own RTSP
	  URL on its own port, and no CPU is spent re-encoding it.

	  Started by /etc/init.d/S96v4l2rtspserver, configured through
	  /etc/v4l2rtspserver.conf.

	  https://github.com/mpromonet/v4l2rtspserver

comment "v4l2rtspserver needs a toolchain w/ C++"
	depends on !BR2_INSTALL_LIBSTDCPP
```
